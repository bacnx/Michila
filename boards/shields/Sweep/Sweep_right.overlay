#include "Sweep.dtsi"

&default_transform { 
    col-offset = <5>;   //right side will start from the offset+1=6th col//
};

&kscan0 {
    col-gpios
            =<&gpio0 17 GPIO_ACTIVE_HIGH>,
			 <&gpio0 20 GPIO_ACTIVE_HIGH>,
             <&gpio0 22 GPIO_ACTIVE_HIGH>, 
             <&gpio0 24 GPIO_ACTIVE_HIGH>, 
             <&gpio1 0 GPIO_ACTIVE_HIGH> 
           ;  

};




